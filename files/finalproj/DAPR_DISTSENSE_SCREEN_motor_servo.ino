/*
  Reading distance from the laser based VL53L1X
  By: Nathan Seidle
  SparkFun Electronics
  Date: April 4th, 2018
  License: This code is public domain but you buy me a beer if you use this and we meet someday (Beerware license).

  SparkFun labored with love to create this code. Feel like supporting open source hardware?
  Buy a board from SparkFun! https://www.sparkfun.com/products/14667

  This example prints the distance to an object.

  Are you getting weird readings? Be sure the vacuum tape has been removed from the sensor.
*/

#include <Wire.h>
#include "SparkFun_VL53L1X.h" //Click here to get the library: http://librarymanager/All#SparkFun_VL53L1X
#include <Adafruit_GFX.h>
#include <Adafruit_SSD1306.h>
#include <Servo.h>

#define SCREEN_WIDTH 128
#define SCREEN_HEIGHT 64

Adafruit_SSD1306 display(SCREEN_WIDTH, SCREEN_HEIGHT, &Wire, -1);

//Optional interrupt and shutdown pins.
#define SHUTDOWN_PIN 2
#define INTERRUPT_PIN 3

//attach servo to RP2040
Servo myServo;

SFEVL53L1X distanceSensor;
//Uncomment the following line to use the optional shutdown and interrupt pins.
//SFEVL53L1X distanceSensor(Wire, SHUTDOWN_PIN, INTERRUPT_PIN);

static const unsigned char PROGMEM EYES_OPEN_array[] = { 
  // ARRAY for DISTRESSED_EYES
0x00, 0x00, 0x00, 0x00, 0x00, 0x00, 0x00, 0x00, 0x00, 0x00, 0x00, 0x00, 0x00, 0x00, 0x00, 0x00, 
  0x00, 0x00, 0x0f, 0xff, 0xe0, 0x00, 0x00, 0x00, 0x00, 0x00, 0xe0, 0x00, 0x00, 0x00, 0xe0, 0x00, 
  0x00, 0x00, 0x7f, 0xff, 0xf8, 0x00, 0x00, 0x00, 0x00, 0x00, 0xf0, 0x00, 0x00, 0x00, 0xf0, 0x00, 
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  0x00, 0x00, 0x00, 0x30, 0x00, 0x00, 0x00, 0x00, 0x00, 0x00, 0x00, 0x00, 0x00, 0x00, 0x40, 0x00, 
};

static const unsigned char PROGMEM EYES_halfWINK_array[] = { 
  // ARRAY for 2nd Array EYES_FRONT 
0x00, 0x00, 0x00, 0x00, 0x00, 0x00, 0x00, 0x00, 0x00, 0x00, 0x00, 0x00, 0x00, 0x00, 0x00, 0x00, 
  0x00, 0x00, 0x0f, 0xff, 0xc0, 0x00, 0x00, 0x00, 0x00, 0x00, 0x00, 0x00, 0x00, 0x00, 0x00, 0x00, 
  0x00, 0x00, 0x7f, 0xff, 0xf0, 0x00, 0x00, 0x00, 0x00, 0x00, 0x00, 0x00, 0x00, 0x00, 0x00, 0x00, 
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  0x00, 0x00, 0x00, 0x60, 0x00, 0x00, 0x00, 0x00, 0x00, 0x00, 0x00, 0x00, 0x00, 0x00, 0x00, 0x00, 

};


static const unsigned char PROGMEM EYES_WINK_array[] = { 
  // ARRAY for 3nd Array EYES_RIGHT
0x00, 0x00, 0x00, 0x50, 0x00, 0x00, 0x00, 0x00, 0x00, 0x00, 0x00, 0x00, 0x00, 0x00, 0x00, 0x00, 
  0x00, 0x00, 0x0f, 0xff, 0x80, 0x00, 0x00, 0x00, 0x00, 0x00, 0x00, 0x00, 0x00, 0x00, 0x00, 0x00, 
  0x00, 0x00, 0x7f, 0xff, 0xf0, 0x00, 0x00, 0x00, 0x00, 0x00, 0x00, 0x00, 0x00, 0x00, 0x00, 0x00, 
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  0x00, 0x00, 0x00, 0xaa, 0x00, 0x00, 0x00, 0x00, 0x00, 0x00, 0x00, 0x00, 0x00, 0x00, 0x00, 0x00, 


};

static const unsigned char PROGMEM EYES_OPEN_array[] = { 
  // ARRAY for DISTRESSED_EYES
0x00, 0x00, 0x00, 0x00, 0x00, 0x00, 0x00, 0x00, 0x00, 0x00, 0x00, 0x00, 0x00, 0x00, 0x00, 0x00, 
  0x00, 0x00, 0x0f, 0xff, 0xe0, 0x00, 0x00, 0x00, 0x00, 0x00, 0xe0, 0x00, 0x00, 0x00, 0xe0, 0x00, 
  0x00, 0x00, 0x7f, 0xff, 0xf8, 0x00, 0x00, 0x00, 0x00, 0x00, 0xf0, 0x00, 0x00, 0x00, 0xf0, 0x00, 
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  0x00, 0x00, 0x00, 0x30, 0x00, 0x00, 0x00, 0x00, 0x00, 0x00, 0x00, 0x00, 0x00, 0x00, 0x40, 0x00, 
};

//setting up the duty cycles for motor control

uint32_t duty_min = int(0.65*65535);
uint32_t duty_max = int(0.9*65535);
uint32_t delay_ms = 500;

void setup(void)
{
  Wire.begin();

  Serial.begin(115200);

  //attaching Servo to appropriate location and setting it to default
  myServo.attach(3);
  myServo.write(90);

  //section from analog write series from fabacademy H-Bridge Documentation
  analogWriteFreq(100000);
  analogWriteRange(65535);

  //testing if screen is there
  Serial.println("VL53L1X Qwiic Test");
     if(!display.begin(SSD1306_SWITCHCAPVCC, 0x3C)) {
    Serial.println(F("SSD1306 allocation failed"));
    for(;;);
  }

  //testing if distance sensor is there
  if (distanceSensor.begin() != 0) //Begin returns 0 on a good init
  {
    Serial.println("Sensor failed to begin. Please check wiring. Freezing...");
    while (1)
      ;
  }
  Serial.println("Sensor online!");

  //setting default eye display and clearing ADAFruit logo.
  display.clearDisplay();
  display.drawBitmap(0, 0, EYES_OPEN_array, 128, 64, 1);
  display.display();
  delay(1500); // Pause for half second
}

void loop(void)
{

  //setting motors to zero power if nothing happens
  analogWrite(4,0);
  analogWrite(2,0);

  distanceSensor.startRanging(); //Write configuration bytes to initiate measurement
  while (!distanceSensor.checkForDataReady())
  {
    delay(1);
  }
  int distance = distanceSensor.getDistance(); //Get the result of the measurement from the sensor
  distanceSensor.clearInterrupt();
  distanceSensor.stopRanging();

  if(distance<300){
      //start turning head one way
      analogWrite(2,0);
      analogWrite(4,duty_max);
      myServo.write(50);

      //change eyes to different mode
      display.clearDisplay();
      display.drawBitmap(0, 0, EYES_WINK_array, 128, 64, 1);
      display.display();
      delay(500);

      myServo.write(150);
      analogWrite(4,0);
      analogWrite(2,0);
      delay(500);
      //turn head other way
      analogWrite(4,0);
      analogWrite(2,duty_max);
      myServo.write(90);
      delay(1000);
      //back to center
      analogWrite(4,0);
      analogWrite(2,0);
      delay(500);
      analogWrite(2,0);
      analogWrite(4,duty_max);
      delay(500);
      analogWrite(4,0);
      analogWrite(2,0);
      delay(500);


  }
  else{
      display.clearDisplay();
      display.drawBitmap(0, 0, EYES_OPEN_array, 128, 64, 1);
      display.display();
  }

  Serial.print("Distance(mm): ");
  Serial.print(distance);
  Serial.println();


}
